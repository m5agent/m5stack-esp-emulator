/* NIST SP 800-38A F.2.1: AES-128 CBC, four blocks through IDF's hardware driver. */
#include <stdio.h>
#include <string.h>
#include "mbedtls/aes.h"
#include "mbedtls/sha256.h"

static const unsigned char key[16] = {
    0x2b,0x7e,0x15,0x16,0x28,0xae,0xd2,0xa6,0xab,0xf7,0x15,0x88,0x09,0xcf,0x4f,0x3c
};
static const unsigned char plain[64] = {
    0x6b,0xc1,0xbe,0xe2,0x2e,0x40,0x9f,0x96,0xe9,0x3d,0x7e,0x11,0x73,0x93,0x17,0x2a,
    0xae,0x2d,0x8a,0x57,0x1e,0x03,0xac,0x9c,0x9e,0xb7,0x6f,0xac,0x45,0xaf,0x8e,0x51,
    0x30,0xc8,0x1c,0x46,0xa3,0x5c,0xe4,0x11,0xe5,0xfb,0xc1,0x19,0x1a,0x0a,0x52,0xef,
    0xf6,0x9f,0x24,0x45,0xdf,0x4f,0x9b,0x17,0xad,0x2b,0x41,0x7b,0xe6,0x6c,0x37,0x10
};
static const unsigned char cipher[64] = {
    0x76,0x49,0xab,0xac,0x81,0x19,0xb2,0x46,0xce,0xe9,0x8e,0x9b,0x12,0xe9,0x19,0x7d,
    0x50,0x86,0xcb,0x9b,0x50,0x72,0x19,0xee,0x95,0xdb,0x11,0x3a,0x91,0x76,0x78,0xb2,
    0x73,0xbe,0xd6,0xb8,0xe3,0xc1,0x74,0x3b,0x71,0x16,0xe6,0x9e,0x22,0x22,0x95,0x16,
    0x3f,0xf1,0xca,0xa1,0x68,0x1f,0xac,0x09,0x12,0x0e,0xca,0x30,0x75,0x86,0xe1,0xa7
};

void app_main(void)
{
    unsigned char iv[16], out[64];
    mbedtls_aes_context ctx;
    mbedtls_aes_init(&ctx);
    puts("C6_AES_START");
    for (unsigned round = 0; round < 3; ++round) {
        for (unsigned i = 0; i < sizeof(iv); ++i) iv[i] = i;
        int rc = mbedtls_aes_setkey_enc(&ctx, key, 128);
        if (!rc) rc = mbedtls_aes_crypt_cbc(&ctx, MBEDTLS_AES_ENCRYPT, sizeof(plain), iv, plain, out);
        if (rc || memcmp(out, cipher, sizeof(cipher))) { printf("C6_AES_FAIL enc %d\n", rc); return; }
        for (unsigned i = 0; i < sizeof(iv); ++i) iv[i] = i;
        rc = mbedtls_aes_setkey_dec(&ctx, key, 128);
        if (!rc) rc = mbedtls_aes_crypt_cbc(&ctx, MBEDTLS_AES_DECRYPT, sizeof(cipher), iv, cipher, out);
        if (rc || memcmp(out, plain, sizeof(plain))) { printf("C6_AES_FAIL dec %d\n", rc); return; }
        printf("C6_AES_CBC_PASS round=%u bytes=%u\n", round, (unsigned)sizeof(plain));
    }
    /* 4096 bytes crosses IDF's 2000-byte interrupt threshold and descriptor boundary. */
    static unsigned char large_in[4096], large_out[4096];
    static const unsigned char expected_hash[32] = {0xa3,0x4c,0x13,0xa4,0x9f,0x34,0x49,0xb5,0x15,0xb9,0x5d,0xcb,0x99,0x67,0x9b,0xa8,0x09,0x7e,0x37,0x04,0x79,0xba,0x29,0x27,0xfc,0xc9,0xcf,0xff,0x0e,0xc4,0xbd,0xba};
    unsigned char hash[32];
    for (unsigned i = 0; i < sizeof(large_in); ++i) large_in[i] = plain[i % sizeof(plain)];
    for (unsigned i = 0; i < sizeof(iv); ++i) iv[i] = i;
    int rc = mbedtls_aes_setkey_enc(&ctx, key, 128);
    if (!rc) rc = mbedtls_aes_crypt_cbc(&ctx, MBEDTLS_AES_ENCRYPT, sizeof(large_in), iv, large_in, large_out);
    if (!rc) rc = mbedtls_sha256(large_out, sizeof(large_out), hash, 0);
    if (rc || memcmp(hash, expected_hash, sizeof(hash))) { printf("C6_AES_FAIL irq-enc %d\n", rc); return; }
    for (unsigned i = 0; i < sizeof(iv); ++i) iv[i] = i;
    rc = mbedtls_aes_setkey_dec(&ctx, key, 128);
    if (!rc) rc = mbedtls_aes_crypt_cbc(&ctx, MBEDTLS_AES_DECRYPT, sizeof(large_out), iv, large_out, large_out);
    if (rc || memcmp(large_out, large_in, sizeof(large_in))) { printf("C6_AES_FAIL irq-dec %d\n", rc); return; }
    puts("C6_AES_DMA_IRQ_PASS bytes=4096");
    mbedtls_aes_free(&ctx);
    puts("C6_AES_READY");
}
